// To get started, press Ctrl+Space to bring up the completion menu and view the available nodes.

// You can also use the buttons in the sidebar to perform actions on nodes.
// Actions currently available include:

// * Enabling / disabling the node
// * Adding the bus to a bus
// * Removing the node
// * Connecting ADC channels

// For more help, browse the DeviceTree documentation at https://docs.zephyrproject.org/latest/guides/dts/index.html
// You can also visit the nRF DeviceTree extension documentation at https://nrfconnect.github.io/vscode-nrf-connect/devicetree/nrfdevicetree.html
/ {
    buttons {
        compatible = "gpio-keys";
        btn1: button1 {
            gpios = < &gpio0 19 (GPIO_PULL_UP | GPIO_ACTIVE_LOW) >;
            label = "Push button switch 1";
        };
    };

    aliases {
        sw0 = &btn1;
    };
};

